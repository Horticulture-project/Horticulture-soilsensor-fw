## boards/arm/stm32f030_horticulture_sensor/Kconfig.defconfig
```kconfig
# Copyright (c) 2019 Antony Pavlov <antonynpavlov@gmail.com>
# SPDX-License-Identifier: Apache-2.0

if BOARD_STM32F030_SENSOR

config BOARD
	default "stm32f030_sensor"

endif # BOARD_STM32F030_SENSOR
```
